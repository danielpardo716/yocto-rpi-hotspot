## layers/meta-hotspot/conf/layer.conf
```bitbake
# We have a conf and classes directory, add to BBPATH
BBPATH .= ":${LAYERDIR}"

# We have recipes-* directories, add to BBFILES
BBFILES += "${LAYERDIR}/recipes-*/*/*.bb \
            ${LAYERDIR}/recipes-*/*/*.bbappend"

BBFILE_COLLECTIONS += "meta-hotspot"
BBFILE_PATTERN_meta-hotspot = "^${LAYERDIR}/"
BBFILE_PRIORITY_meta-hotspot = "6"

LAYERDEPENDS_meta-hotspot = "core"
LAYERSERIES_COMPAT_meta-hotspot = "kirkstone"
```
